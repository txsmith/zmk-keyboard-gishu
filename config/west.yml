## config/west.yml
```yaml
manifest:
  remotes:
    - name: zmkfirmware
      url-base: https://github.com/zmkfirmware
  projects:
    - name: zmk
      remote: zmkfirmware
      revision: e34793e8c7193bc868b95ec38d78f67956f759cb
      import: app/west.yml
  self:
    path: config
```
