## Kconfig
```kconfig
# Copyright (c) 2025 The ZMK Contributors
# SPDX-License-Identifier: MIT

rsource "drivers/Kconfig"

if ZMK_INDICATOR_LED_STRIP

config ZMK_INDICATOR_LED_BRIGHTNESS
    int "LED indicator brightness (0-100)"
    range 0 100
    default 15
    help
      Maximum brightness for the LED indicator strip.
      Value between 0 (off) and 100 (full brightness).

endif # ZMK_INDICATOR_LED_STRIP
```

## boards/arm/gishu/Kconfig
```kconfig
config BOARD_ENABLE_DCDC
    bool "Enable DCDC mode"
    select SOC_DCDC_NRF52X
    default y
    depends on BOARD_GISHU

config ZMK_INDICATOR_LED_STRIP
    bool "Enable RGB LED strip for showing battery and output status"
```

## boards/arm/gishu/Kconfig.defconfig
```kconfig
if BOARD_GISHU

config ZMK_KEYBOARD_NAME
    default "Gishu"

if USB

config USB_NRFX
    default y

config USB_DEVICE_STACK
    default y

endif # USB

config BT_CTLR
    default BT

config ZMK_BLE
    default y

config ZMK_USB
    default y

endif # BOARD_GISHU
```

## boards/arm/gishu/gishu_defconfig
```kconfig
CONFIG_BOARD_GISHU=y
CONFIG_SOC_SERIES_NRF52X=y
CONFIG_SOC_NRF52840_QIAA=y

CONFIG_ARM_MPU=y
CONFIG_GPIO=y
CONFIG_PINCTRL=y

CONFIG_USE_DT_CODE_PARTITION=y
CONFIG_BUILD_OUTPUT_UF2=y

CONFIG_MPU_ALLOW_FLASH_WRITE=y
CONFIG_NVS=y
CONFIG_SETTINGS_NVS=y
CONFIG_FLASH=y
CONFIG_FLASH_PAGE_LAYOUT=y
CONFIG_FLASH_MAP=y

CONFIG_I2C=y
CONFIG_ZMK_SLEEP=y

CONFIG_ZMK_EXT_POWER=y

CONFIG_ZMK_MAX17055=y

CONFIG_ZMK_INDICATOR_LED_STRIP=y
CONFIG_ZMK_INDICATOR_LED_BRIGHTNESS=10

CONFIG_ZMK_BATTERY_REPORT_INTERVAL=30
CONFIG_ZMK_IDLE_TIMEOUT=120000
CONFIG_ZMK_BATTERY_REPORTING_FETCH_MODE_STATE_OF_CHARGE=y
```

## boards/gishu/Kconfig
```kconfig
config BOARD_ENABLE_DCDC
    bool "Enable DCDC mode"
    select SOC_DCDC_NRF52X
    default y
    depends on BOARD_GISHU

config BOARD_ENABLE_DCDC_HV
    bool "High voltage DCDC converter"
    select SOC_DCDC_NRF52X_HV
    default y
    depends on BOARD_GISHU

config ZMK_INDICATOR_LED_STRIP
    bool "Enable RGB LED strip for showing battery and output status"
```

## boards/gishu/Kconfig.defconfig
```kconfig
if BOARD_GISHU

config ZMK_KEYBOARD_NAME
    default "Gishu"


if USB

config USB_NRFX
    default y

config USB_DEVICE_STACK
    default y

endif # USB


config BT_CTLR
    default BT

config ZMK_BLE
    default y

config ZMK_USB
    default y

config ZMK_INDICATOR_LED_STRIP
    default y
    select SPI
    select LED_STRIP
    select WS2812_STRIP

endif # BOARD_GISHU
```

## boards/gishu/board.yml
```yaml
board:
  name: gishu
  vendor: gishu
  socs:
    - name: nrf52840
  revision:
    format: major.minor.patch
    default: 0.2.0
    revisions:
      - name: 0.1.0
      - name: 0.2.0
      - name: 0.3.0
```

## drivers/sensor/Kconfig
```kconfig
# Copyright (c) 2025 The ZMK Contributors
# SPDX-License-Identifier: MIT

rsource "max17055/Kconfig"
```

## drivers/sensor/max17055/Kconfig
```kconfig
# Copyright (c) 2025 The ZMK Contributors
# SPDX-License-Identifier: MIT

menuconfig ZMK_MAX17055
    bool "MAX17055 I2C-based Fuel Gauge (ZMK version)"
    default y
    depends on DT_HAS_ZMK_MAXIM_MAX17055_ENABLED && I2C
    select ZMK_BATTERY
    help
      Enable ZMK's version of the MAX17055 I2C-based Fuel Gauge driver.
      This is a copy of the Zephyr driver with ZMK-specific modifications
      and debugging improvements.

if ZMK_MAX17055

config SENSOR_MAX17055_INIT_PRIORITY
    int "Init priority"
    default 75
    help
      Device driver initialization priority.

endif #ZMK_MAX17055
```

## dts/bindings/sensor/zmk,maxim-max17055.yaml
```yaml
#
# Copyright (c) 2025 The ZMK Contributors
#
# SPDX-License-Identifier: MIT
#

description: >
  ZMK's MAX17055 I2C Fuel Gauge driver.
  Based on the upstream Zephyr driver with ZMK-specific modifications
  and debugging improvements for battery integration.

compatible: "zmk,maxim-max17055"

include: [sensor-device.yaml, i2c-device.yaml]

properties:
  design-capacity:
    type: int
    required: true
    description: >
      Battery design capacity in mAh.
      Used for accurate fuel gauge calculations.

  design-voltage:
    type: int
    required: true
    description: >
      Battery design voltage in mV.
      Typical values: 3700mV for Li-ion, 3800mV for LiFePO4.

  desired-voltage:
    type: int
    required: true
    description: >
      Maximum charge voltage in mV.
      Typical values: 4200mV for Li-ion, 3600mV for LiFePO4.

  desired-charging-current:
    type: int
    required: true
    description: >
      Desired charging current in mA.
      Should match your charger capability.

  i-chg-term:
    type: int
    required: true
    description: >
      Charge termination current in mA.
      Current level at which charging is considered complete.

  rsense-mohms:
    type: int
    required: true
    description: >
      Current sense resistor value in milliohms.
      Typical values are 10mΩ or 20mΩ.

  v-empty:
    type: int
    required: true
    description: >
      Empty voltage in mV.
      Voltage level considered as battery empty.
```
